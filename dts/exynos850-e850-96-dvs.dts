// SPDX-License-Identifier: GPL-2.0
/* Upstream E850-96 board plus the DVS I2C/reset integration. */
#include "exynos850-e850-96.dts"
#include "exynos850-e850-96-dvs.dtsi"

/* Preserve the previous WLBT carveout even while WLAN is disabled.
 * Allocate 12 MiB below the secure-memory boundary, aligned to 1 MiB.
 */
/ {
	reserved-memory {
		wlbt_mem: wlbt-test-memory {
			size = <0x00c00000>;
			alignment = <0x0 0x00100000>;
			alloc-ranges = <0x0 0x80000000 0x3ab00000>;
			no-map;
		};
	};
};
